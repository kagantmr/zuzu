## kernel/Kconfig
```kconfig
menu "Kernel debugging"

config ZUZU_BENCH
	bool "PMCCNTR min/avg/max instrumentation"
	default n
	help
	  Fixed measurement points (kernel/bench.h). Compiled out entirely when
	  off, so a production build carries no footprint.

endmenu
```
